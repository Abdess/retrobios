## tests/fixtures/romfolders/es/recalbox/configs/recalbox-rpi1_defconfig
```kconfig
BR2_PACKAGE_RECALBOX_TARGET_RPI1=y
BR2_PACKAGE_LIBRETRO_PCSX_REARMED=y
BR2_PACKAGE_LIBRETRO_SWANSTATION=y
BR2_PACKAGE_LIBRETRO_BEETLE_PSX=y
BR2_PACKAGE_LIBRETRO_MAME2003_PLUS=y
```

## tests/fixtures/romfolders/es/recalbox/configs/recalbox-rpi3_defconfig
```kconfig
BR2_PACKAGE_RECALBOX_TARGET_RPI3=y
BR2_PACKAGE_LIBRETRO_PCSX_REARMED=y
BR2_PACKAGE_LIBRETRO_SWANSTATION=y
BR2_PACKAGE_LIBRETRO_MAME2003_PLUS=y
# BR2_PACKAGE_LIBRETRO_VECX is not set
```

## tests/fixtures/romfolders/es/recalbox/configs/recalbox-x86_64_defconfig
```kconfig
BR2_PACKAGE_RECALBOX_TARGET_X86_64=y
BR2_PACKAGE_LIBRETRO_PCSX_REARMED=y
BR2_PACKAGE_LIBRETRO_SWANSTATION=y
BR2_PACKAGE_LIBRETRO_MAME2003_PLUS=y
BR2_PACKAGE_LIBRETRO_MAME=y
```
